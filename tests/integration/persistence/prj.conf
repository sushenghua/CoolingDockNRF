## CMakeLists.txt
```
cmake_minimum_required(VERSION 3.20.0)
find_package(Zephyr REQUIRED HINTS $ENV{ZEPHYR_BASE})
project(test_persistence)

# Real production sources we want to exercise
target_sources(app PRIVATE
	src/test_persistence.c
	src/stubs.c
	${CMAKE_CURRENT_SOURCE_DIR}/../../../src/sys_data.c
	${CMAKE_CURRENT_SOURCE_DIR}/../../../src/json_io.c
	${CMAKE_CURRENT_SOURCE_DIR}/../../../src/cmd_interpreter.c
)

target_include_directories(app PRIVATE
	${CMAKE_CURRENT_SOURCE_DIR}/../../../src
)

# sys_data.c uses CONFIG_BT_DEVICE_NAME as a default-name string. That
# symbol only exists with CONFIG_BT=y. We inject it directly so tests
# don't need to drag the BT subsystem in.
target_compile_definitions(app PRIVATE
	CONFIG_BT_DEVICE_NAME=\"CoolingDockNRF\"
)

# Sanitizers + coverage. ASan needs more main stack on native_sim, see prj.conf.
target_compile_options(app PRIVATE
	-Wall -Wextra
	-fsanitize=address -fsanitize=undefined
	-fno-sanitize-recover=all
	--coverage
)
target_link_options(app PRIVATE
	-fsanitize=address -fsanitize=undefined
	--coverage
)
```

## prj.conf
```kconfig
CONFIG_ZTEST=y

# We need the real settings + NVS stack on top of the flash simulator
# that ships with the native_sim board. Persistence is what we're testing.
CONFIG_FLASH=y
CONFIG_FLASH_PAGE_LAYOUT=y
CONFIG_FLASH_MAP=y
CONFIG_NVS=y
CONFIG_SETTINGS=y
CONFIG_SETTINGS_NVS=y

CONFIG_LOG=y
CONFIG_LOG_DEFAULT_LEVEL=2

# native_sim with ASan needs significant headroom.
CONFIG_MAIN_STACK_SIZE=32768
CONFIG_HEAP_MEM_POOL_SIZE=8192

# Note: sys_data.c references CONFIG_BT_DEVICE_NAME as a default name
# string. That symbol only exists with CONFIG_BT=y, which we don't want
# to enable here. We inject it as a plain compile definition in
# CMakeLists.txt instead.
```

## src/stubs.c
```c
/* Stubs for the headers cmd_interpreter pulls in but we can't link
 * against in this test (sensor needs SHT3x driver, control needs the
 * fan PWM hardware, ble_svc needs the BT host). The stubs return
 * deterministic values so cmd_interpreter behaves predictably.
 */

#include <errno.h>
#include <stddef.h>
#include "sensor.h"
#include "control.h"
#include "ble_svc.h"

/* sensor.h */
int sensor_get(struct sensor_reading *out)
{
	(void)out;
	return -EAGAIN;            /* "no sample yet" — status JSON shows null */
}

void sensor_start(void)        { /* no-op */ }

/* control.h */
uint8_t     control_get_actual_pwm(void) { return 0; }
const char *control_get_status(void)     { return "stopped"; }
void        control_start(void)          { /* no-op */ }

/* ble_svc.h — record name applications so tests can assert on them */
static char last_applied_name[64];

int ble_svc_apply_name(const char *name)
{
	if (!name) return -EINVAL;
	size_t i = 0;
	while (name[i] && i < sizeof(last_applied_name) - 1) {
		last_applied_name[i] = name[i];
		i++;
	}
	last_applied_name[i] = '\0';
	return 0;
}

const char *test_last_applied_name(void)
{
	return last_applied_name;
}

int ble_svc_start(void) { return 0; }
```

## src/test_persistence.c
```c
/* Integration test for the cmd → sys_data → settings → reload pipeline.
 *
 * Compiled directly against the production sys_data.c, json_io.c, and
 * cmd_interpreter.c — the small slice of Zephyr API they consume is
 * shimmed in tests/integration/persistence/fakes/. The shimmed
 * settings backend is an in-memory key→bytes map; everything else
 * (the cmd dispatch, validation, JSON, sys_data wrapping) is the real
 * production code under test.
 */

#include "test_harness.h"

#include <string.h>

#include "sys_data.h"
#include "cmd_interpreter.h"
#include "zephyr/settings/settings.h"   /* for _shim_settings_reset */

extern const char *test_last_applied_name(void);

/* Most TESTs need a clean store. Easiest is to call the reset helper
 * at the top of each test. */
#define RESET_STATE() \
	do { \
		_shim_settings_reset(); \
		(void)sys_data_factory_reset(); \
		(void)sys_data_init(); \
	} while (0)

TEST(persistence_set_peripheral_sensor_persists_thresholds)
{
	RESET_STATE();
	const char *cmd =
		"{\"cmd\":\"SetPeripheralConfig\",\"index\":0,\"mode\":\"sensor\","
		"\"thr1\":20,\"thr2\":30,\"retfmt\":\"json\"}";
	char resp[128];
	ssize_t n = cmd_interpreter_dispatch(cmd, strlen(cmd), resp, sizeof(resp));
	ASSERT_TRUE(n > 0, "dispatch returned %zd", n);
	ASSERT_NOT_NULL(strstr(resp, "\"code\":0"), "resp=%s", resp);

	struct prf_cfg cfg;
	ASSERT_EQ(sys_data_get_prf(0, &cfg), 0);
	ASSERT_EQ(cfg.mode, PRF_MODE_SENSOR);
	ASSERT_EQ(cfg.thr1_c, 20);
	ASSERT_EQ(cfg.thr2_c, 30);
}

TEST(persistence_set_peripheral_survives_reboot)
{
	RESET_STATE();

	/* Apply config */
	const char *cmd =
		"{\"cmd\":\"SetPeripheralConfig\",\"index\":0,\"mode\":\"sensor\","
		"\"thr1\":18,\"thr2\":28}";
	char resp[128];
	(void)cmd_interpreter_dispatch(cmd, strlen(cmd), resp, sizeof(resp));

	/* Override with different values and persist */
	const char *override =
		"{\"cmd\":\"SetPeripheralConfig\",\"index\":0,\"mode\":\"power\","
		"\"pwr\":true}";
	(void)cmd_interpreter_dispatch(override, strlen(override), resp, sizeof(resp));

	/* "Reboot" — re-init sys_data from the persisted store */
	(void)sys_data_init();

	struct prf_cfg cfg;
	(void)sys_data_get_prf(0, &cfg);
	ASSERT_EQ(cfg.mode, PRF_MODE_POWER);
	ASSERT_TRUE(cfg.pwr);
}

TEST(persistence_master_control_round_trip)
{
	RESET_STATE();

	const char *off = "{\"cmd\":\"SetMasterControl\",\"on\":false}";
	char resp[64];
	(void)cmd_interpreter_dispatch(off, strlen(off), resp, sizeof(resp));
	ASSERT_FALSE(sys_data_get_master());

	const char *on = "{\"cmd\":\"SetMasterControl\",\"on\":true}";
	(void)cmd_interpreter_dispatch(on, strlen(on), resp, sizeof(resp));
	ASSERT_TRUE(sys_data_get_master());
}

TEST(persistence_set_device_name_persists_and_propagates)
{
	RESET_STATE();

	const char *cmd = "{\"cmd\":\"SetDeviceName\",\"name\":\"CoolingDock_X\"}";
	char resp[64];
	ssize_t n = cmd_interpreter_dispatch(cmd, strlen(cmd), resp, sizeof(resp));
	ASSERT_TRUE(n > 0);
	ASSERT_NOT_NULL(strstr(resp, "\"code\":0"));

	char name[24];
	ASSERT_EQ(sys_data_get_name(name, sizeof(name)), 0);
	ASSERT_STR_EQ(name, "CoolingDock_X");

	/* SetDeviceName must also push to BLE host via ble_svc_apply_name. */
	ASSERT_STR_EQ(test_last_applied_name(), "CoolingDock_X");
}

TEST(persistence_bad_mode_rejected_without_mutation)
{
	RESET_STATE();
	struct prf_cfg before;
	(void)sys_data_get_prf(0, &before);

	const char *bad =
		"{\"cmd\":\"SetPeripheralConfig\",\"index\":0,\"mode\":\"bogus\"}";
	char resp[64];
	(void)cmd_interpreter_dispatch(bad, strlen(bad), resp, sizeof(resp));
	ASSERT_NOT_NULL(strstr(resp, "\"code\":3"));
	ASSERT_NOT_NULL(strstr(resp, "\"val\":\"bad mode\""));

	struct prf_cfg after;
	(void)sys_data_get_prf(0, &after);
	ASSERT_EQ(memcmp(&before, &after, sizeof(before)), 0);
}

TEST(persistence_sensor_mode_thr1_ge_thr2_rejected)
{
	RESET_STATE();
	struct prf_cfg before;
	(void)sys_data_get_prf(0, &before);

	const char *bad =
		"{\"cmd\":\"SetPeripheralConfig\",\"index\":0,\"mode\":\"sensor\","
		"\"thr1\":40,\"thr2\":40}";
	char resp[64];
	(void)cmd_interpreter_dispatch(bad, strlen(bad), resp, sizeof(resp));
	ASSERT_NOT_NULL(strstr(resp, "\"val\":\"thr2<=thr1\""));

	struct prf_cfg after;
	(void)sys_data_get_prf(0, &after);
	ASSERT_EQ(memcmp(&before, &after, sizeof(before)), 0);
}

TEST(persistence_unknown_cmd_returns_unsupp)
{
	RESET_STATE();

	const char *bad = "{\"cmd\":\"FlyToTheMoon\"}";
	char resp[64];
	(void)cmd_interpreter_dispatch(bad, strlen(bad), resp, sizeof(resp));
	ASSERT_NOT_NULL(strstr(resp, "\"code\":4"));
}

TEST(persistence_get_status_does_not_crash_without_sample)
{
	RESET_STATE();

	const char *cmd = "{\"cmd\":\"GetStatusData\"}";
	char resp[256];
	ssize_t n = cmd_interpreter_dispatch(cmd, strlen(cmd), resp, sizeof(resp));
	ASSERT_TRUE(n > 0);
	/* sensor stub returns -EAGAIN, so jsf_status emits null fields. */
	ASSERT_NOT_NULL(strstr(resp, "\"temp\":null"));
	ASSERT_NOT_NULL(strstr(resp, "\"humid\":null"));
}
```
