## tests/integration/persistence/testcase.yaml
```yaml
tests:
  app.persistence:
    harness: ztest
    timeout: 60
    tags:
      - app
      - integration
    platform_allow:
      - native_sim
      - native_sim/native/64
    integration_platforms:
      - native_sim
```
